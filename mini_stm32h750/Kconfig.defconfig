## mini_stm32h750/Kconfig.defconfig
```kconfig
# WeAct Studio MINI STM32H750VB board configuration

if BOARD_MINI_STM32H750

if DISPLAY

# MEMC needs to be enabled in order to store
# display buffer to external SDRAM connected to FMC
config MEMC
	default y

endif # DISPLAY

endif # BOARD_MINI_STM32H750
```

## stm32f103_core/board.yml
```yaml
board:
  name: weact_stm32f103_core
  vendor: st
  socs:
    - name: stm32f103xb
```

## stm32f103c8t6_mini/board.yml
```yaml
board:
  name: stm32f103c8t6_mini
  vendor: other
  socs:
    - name: stm32f103xb
```

## weact_stm32h723_core/Kconfig.defconfig
```kconfig
# STM32H723VG Weact core board configuration

if BOARD_WEACT_STM32H723_CORE

if NETWORKING

config NET_L2_ETHERNET
	default y

endif # NETWORKING

config USB_DC_HAS_HS_SUPPORT
	default y
	depends on USB_DC_STM32

endif # BOARD_WEACT_STM32H723_CORE
```

## weact_stm32h723_core/board.yml
```yaml
board:
  name: weact_stm32h723_core
  vendor: weact
  socs:
    - name: stm32h723xx
```

## weact_stm32wb55_core/Kconfig.defconfig
```kconfig
# STM32WB55CG Weact core board configuration

if BOARD_WEACT_STM32WB55_CORE

config BT_STM32_IPM
	default y
	depends on BT

endif
```

## weact_stm32wb55_core/board.yml
```yaml
board:
  name: weact_stm32wb55_core
  vendor: st
  socs:
    - name: stm32wb55xx
```
